## Kconfig
```kconfig
# The configuration of Tenok. What a board is made of stays in the makefile of
# that board; what is written here is what somebody building Tenok chooses.

mainmenu "Tenok Configuration"

menu "Platform"

choice
	prompt "Board"
	default PLATFORM_QEMU
	help
	  The board the firmware is built for. Every board compiles the same
	  sources with different pins, clocks and drivers.

config PLATFORM_QEMU
	bool "QEMU (netduinoplus2)"
	help
	  The machine QEMU emulates, which is an STM32F405 with a console on
	  the first UART. Nothing else of the board is there.

config PLATFORM_STM32F4DISC
	bool "STM32F4 Discovery"

config PLATFORM_STM32F429DISC
	bool "STM32F429I Discovery"
	select HAS_FRAMEBUFFER
	select HAS_SDRAM
	help
	  The board with the 240x320 panel the display controller draws on and
	  the SDRAM the user space allocates from.

config PLATFORM_NUCLEO_F746ZG
	bool "NUCLEO-F746ZG"
	help
	  The board with a Cortex-M7, for which ST wrote no Standard Peripheral
	  Library. What it drives its peripherals with is the Low Layer of
	  STM32Cube.

config PLATFORM_DYNAMICS_WIZARD
	bool "Dynamics Wizard"

endchoice

config PLATFORM
	string
	default "qemu" if PLATFORM_QEMU
	default "stm32f4disc" if PLATFORM_STM32F4DISC
	default "stm32f429disc" if PLATFORM_STM32F429DISC
	default "dynamics_wizard" if PLATFORM_DYNAMICS_WIZARD
	default "nucleo_f746zg" if PLATFORM_NUCLEO_F746ZG

# What a board brings that another does not, so that what needs it can say so
config HAS_FRAMEBUFFER
	bool

config HAS_SDRAM
	bool

endmenu

source "kernel/Kconfig"
source "user/Kconfig"

menu "NUCLEO-F746ZG console"
	depends on PLATFORM_NUCLEO_F746ZG

choice
	prompt "Which port the terminal is on"
	default CONSOLE_VCP
	help
	  The board carries one serial port to the host over the same cable that
	  flashes it, through the debugger at the far end. That is the least to
	  wire and the most to go wrong: the debugger's serial port is a USB
	  device of its own and drops off the bus under sustained output on some
	  hosts. The other choices leave the board on a pin header, to be wired
	  to a converter of the reader's own.

config CONSOLE_VCP
	bool "Through the debugger (USART3, PD8/PD9)"
	help
	  Nothing to wire. Appears on the host as the same device the debugger
	  uses.

config CONSOLE_USART6
	bool "On the header, USART6 (PG14 tx, PG9 rx)"
	help
	  The pins an Arduino shield expects its serial port on. Wire tx to the
	  converter's rx, rx to its tx, and grounds together.

config CONSOLE_USART2
	bool "On the header, USART2 (PD5 tx, PD6 rx)"
	help
	  Port D, which nothing else on this board uses once the terminal is
	  moved off it. No relationship to the Ethernet pins at all.

endchoice

endmenu

menu "Network"

config NET
	bool "Networking"
	help
	  A TCP/IP stack, and the Ethernet controller under it. The address the
	  board answers to is fixed here: nothing on the far end of the cable is
	  assumed to be handing addresses out.

if NET

config NET_IPV4_ADDR0
	int "Address, first octet"
	default 118
config NET_IPV4_ADDR1
	int "Address, second octet"
	default 163
config NET_IPV4_ADDR2
	int "Address, third octet"
	default 201
config NET_IPV4_ADDR3
	int "Address, fourth octet"
	default 12

config NET_IPV4_MASK0
	int "Mask, first octet"
	default 255
config NET_IPV4_MASK1
	int "Mask, second octet"
	default 255
config NET_IPV4_MASK2
	int "Mask, third octet"
	default 255
config NET_IPV4_MASK3
	int "Mask, fourth octet"
	default 0

config NET_IPV4_GW0
	int "Gateway, first octet"
	default 118
config NET_IPV4_GW1
	int "Gateway, second octet"
	default 163
config NET_IPV4_GW2
	int "Gateway, third octet"
	default 201
config NET_IPV4_GW3
	int "Gateway, fourth octet"
	default 254

config NET_IPV4_DNS0
	int "Name server, first octet"
	default 168
config NET_IPV4_DNS1
	int "Name server, second octet"
	default 95
config NET_IPV4_DNS2
	int "Name server, third octet"
	default 1
config NET_IPV4_DNS3
	int "Name server, fourth octet"
	default 1

endif

endmenu
```

## configs/stm32f429disc_defconfig
```kconfig
CONFIG_PLATFORM_STM32F429DISC=y
CONFIG_DIRECTFB2=y
CONFIG_DIRECTFB2_GEARS=y
CONFIG_DIRECTFB2_WINDOW=y
CONFIG_DIRECTFB2_FIRE=y
CONFIG_DIRECTFB2_PALETTE=y
CONFIG_DIRECTFB2_PARTICLE=y
CONFIG_DIRECTFB2_MATRIX=y
CONFIG_DIRECTFB2_VKCOLOR=y
```

## kernel/Kconfig
```kconfig
# What the kernel is sized to. Every one of these was a number written down in
# kconfig.h, which now says only which name the kernel knows each one by.

menu "Kernel"

comment "Scheduler"

config OS_TICK_FREQ
	int "Ticks per second"
	default 100 if PLATFORM_QEMU
	default 4000
	range 10 10000
	help
	  How often the scheduler is given the chance to change threads. QEMU
	  is given far fewer, since a tick there costs what a tick on the board
	  does not.

config THREAD_PRIORITY_MAX
	int "Highest priority a user thread can be given"
	default 8
	range 1 32

choice
	prompt "Page size"
	default PAGE_SIZE_64K_SELECT
	help
	  How much memory the page allocator hands out, which is also the
	  largest stack a thread can be given.

config PAGE_SIZE_32K_SELECT
	bool "32 KiB"

config PAGE_SIZE_64K_SELECT
	bool "64 KiB"

endchoice

comment "Stacks"

config STACK_SIZE_MIN
	int "Smallest stack a task or thread is given"
	default 1024
	range 256 65536
	help
	  What a thread is given when it asks for none, and the least it is
	  allowed to ask for.

config INIT_STACK_SIZE
	int "Stack of the init thread"
	default 4096

config IDLE_STACK_SIZE
	int "Stack of the idle thread"
	default 1024

config SOFTIRQD_STACK_SIZE
	int "Stack of the softirq daemon"
	default 2048

config FILESYSD_STACK_SIZE
	int "Stack of the file system daemon"
	default 2048

config PRINTKD_STACK_SIZE
	int "Stack of the log daemon"
	default 1024

comment "Tasks and threads"

config TASK_MAX
	int "Tasks the system holds at once"
	default 32
	range 1 256

config THREAD_MAX
	int "Threads the system holds at once"
	default 32
	range 1 256

config THREAD_NAME_MAX
	int "Longest name a thread can be given"
	default 50

config PTHREAD_KEYS_MAX
	int "Thread-local storage keys"
	default 8
	range 1 128
	help
	  A key names a slot that every thread has one of, so the count is paid
	  for by every thread whether it uses one or not.

config PTHREAD_DESTRUCTOR_ITERATIONS
	int "Turns a thread-local destructor is given"
	default 4
	range 1 16
	help
	  How many times over a destructor that leaves a new value behind is
	  called again before the system gives up on it.

comment "Message queues and pipes"

config MQUEUE_MAX
	int "Message queues the system holds at once"
	default 16

config MQ_PRIO_MAX
	int "Message priorities"
	default 5

config THREAD_PIPE_BUF
	int "Reply pipe every thread is given"
	default 100
	help
	  What the file system daemon answers a thread through. Every thread
	  pays for this one, so it is kept small. Too small and the daemon does
	  not work.

config PIPE_BUF
	int "How much a pipe holds"
	default 512
	help
	  POSIX also makes this the largest write that reaches a pipe whole.
	  Only a live pipe pays for it.

comment "Signals"

config SIGNAL_QUEUE_SIZE
	int "Signals a thread can have waiting"
	default 5

comment "Standard input and output"

config STDIN_PATH
	string "Where standard input is read from"
	default "/dev/console"

config STDOUT_PATH
	string "Where standard output is written to"
	default "/dev/console"

config STDERR_PATH
	string "Where standard error is written to"
	default "/dev/console"

config PRINT_SIZE_MAX
	int "Buffer of printf() and printk()"
	default 100

config USE_TENOK_PRINTF
	bool "Use the printf() Tenok writes"
	default y
	help
	  Tenok has a printf() of its own, which is smaller than the one the C
	  library brings. Say no to use the library's instead.

comment "File system"

config NAME_MAX
	int "Longest file name"
	default 30

config PATH_MAX
	int "Longest pathname"
	default 128

config FILE_OPEN_MAX
	int "Files a task can have open"
	default 100

config FILE_MAX
	int "Files the system can hold"
	default 100

config INODE_MAX
	int "Inodes the system can hold"
	default 100

config MOUNT_MAX
	int "Storages that can be mounted"
	default 5

config FS_BLK_SIZE
	int "Block of the file system"
	default 128

config FS_BLK_CNT
	int "Blocks of the file system"
	default 100

comment "Shell"

config LINE_MAX
	int "Longest line the shell reads"
	default 128

config SHELL_HISTORY_MAX
	int "Lines the shell remembers"
	default 10

endmenu
```

## user/Kconfig
```kconfig
# What is built into the firmware besides the kernel itself.

menu "User space"

config BUSYBOX
	bool "BusyBox"
	default y
	help
	  The applets of BusyBox, reached through the shell. Tenok has neither
	  fork() nor exec(), so every applet is run in process.

menuconfig DIRECTFB2
	bool "DirectFB2"
	depends on HAS_FRAMEBUFFER
	help
	  The graphics library, which draws through /dev/fb0 onto the panel of
	  the board. It is built through the path it already has for NuttX.

if DIRECTFB2

config DIRECTFB2_DFB
	bool "dfb, which draws what it takes to see the display is working"
	default y

comment "Examples of DirectFB2"

config DIRECTFB2_GEARS
	bool "gears, the turning gears drawn through OpenGL"
	help
	  There is no graphics processor on this board, so the OpenGL is
	  PortableGL, which draws with the processor like everything else.
	  It brings the largest part of the firmware with it.

config DIRECTFB2_WINDOW
	bool "window, which stacks windows on the display layer"

config DIRECTFB2_FIRE
	bool "fire, which draws a fire straight into the pixels of a surface"

config DIRECTFB2_PALETTE
	bool "palette, which draws through a palette surface"

config DIRECTFB2_PARTICLE
	bool "particle, which draws a field of particles"

config DIRECTFB2_MATRIX
	bool "matrix, which draws through a transformation matrix"

config DIRECTFB2_VKCOLOR
	bool "vkcolor, which draws the colour keying of a surface"

endif

config OPTS
	bool "Open POSIX Test Suite"
	help
	  The conformance tests of POSIX, run by the "opts" shell command. The
	  suite is fetched rather than kept in the tree:

	      ./scripts/download-posix-tests.sh

	  Which of its tests are built is worked out by the build. A test that
	  names something Tenok does not have is left out, so the number that
	  run says what the system has.

endmenu
```
